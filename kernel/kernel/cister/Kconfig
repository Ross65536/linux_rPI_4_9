## kernel/kernel/cister/Kconfig
```kconfig
menu "CISTER framework"
config CISTER_FRAMEWORK
	bool "CISTER Framework"
	default y

config CISTER_TRACING
	bool "CISTER tracing"
	default y
	depends on CISTER_FRAMEWORK

config CISTER_RT_SCHEDULERS
	bool "CISTER scheduling policy:EDF"
	default y
	depends on CISTER_FRAMEWORK


endmenu
```
